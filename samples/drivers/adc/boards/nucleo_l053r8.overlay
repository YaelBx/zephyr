/*
 * SPDX-License-Identifier: Apache-2.0
 *
 * Copyright (c) 2021 Yael Boutreux <yael.boutreux@gmail.com>
 */

/ {
	zephyr,user {
		/* adjust channel number according to pinmux in board.dts */
		io-channels = <&adc1 0>;
	};
};

&adc1 {
	pinctrl-0 = <&adc_in0_pa0>;
	status = "okay";
};